## conf/layer.conf
```bitbake
# We have a conf and classes directory, append to BBPATH
BBPATH .= ":${LAYERDIR}"

# We have a recipes directory, add to BBFILES
BBFILES += "${LAYERDIR}/recipes*/*/*.bb ${LAYERDIR}/recipes*/*/*.bbappend"

BBFILE_COLLECTIONS += "meta-orangepiwinplus"
BBFILE_PATTERN_meta-orangepiwinplus := "^${LAYERDIR}/"
BBFILE_PRIORITY_meta-orangepiwinplus = "10"

# This should only be incremented on significant changes that will
# cause compatibility issues with other layers
LAYERVERSION_meta-orangepiwinplus = "1"

LAYERDEPENDS_meta-orangepiwinplus = "core openembedded-layer"

LAYERSERIES_COMPAT_meta-orangepiwinplus = "zeus dunfell"
```
